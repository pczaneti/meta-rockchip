## conf/machine/rockchip-rv1106-evb.conf
```bitbake
# Copyright (c) 2024, Rockchip Electronics Co., Ltd
# Released under the MIT license (see COPYING.MIT for the terms)

#@TYPE: Machine
#@NAME: RK3506 EVB

require conf/machine/include/rv1106.inc

KERNEL_DEVICETREE = "rv1106g-luckfox-pico-ultra-w.dtb"

UBOOT_MACHINE = "luckfox_rv1106_uboot_defconfig"
RK_UBOOT_SPL = "1"

INIT_MANAGER = "systemd"

EXTRA_IMAGE_FEATURES += "ssh-server-openssh"

INHERIT:append = " rockchip-image"

PREFERRED_VERSION_linux-rockchip := "5.10%"
LINUXLIBCVERSION := "5.10-custom%"
```
